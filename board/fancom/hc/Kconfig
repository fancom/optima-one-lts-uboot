## board/fancom/hc/Kconfig
```kconfig
if TARGET_FANCOM_HC

config SYS_BOARD
        default "hc"

config SYS_VENDOR
        default "fancom"

config SYS_SOC
        default "bcm283x"

config SYS_CONFIG_NAME
        default "hc"

config RPI_EFI_NR_SPIN_PAGES
	int "Spin table page count"
	default 1
	help
	  Number of pages to reserve starting at page 0 for spin tables in the EFI
	  memory map

endif
```

## board/fancom/hmi/Kconfig
```kconfig
if TARGET_FANCOM_HMI

config SYS_BOARD
        default "hmi"

config SYS_VENDOR
        default "fancom"

config SYS_SOC
        default "bcm283x"

config SYS_CONFIG_NAME
        default "hmi"

config RPI_EFI_NR_SPIN_PAGES
	int "Spin table page count"
	default 1
	help
	  Number of pages to reserve starting at page 0 for spin tables in the EFI
	  memory map

endif
```

## board/fancom/whc/Kconfig
```kconfig
if TARGET_FANCOM_WHC

config SYS_BOARD
        default "whc"

config SYS_VENDOR
        default "fancom"

config SYS_SOC
        default "bcm283x"

config SYS_CONFIG_NAME
        default "whc"

config RPI_EFI_NR_SPIN_PAGES
	int "Spin table page count"
	default 1
	help
	  Number of pages to reserve starting at page 0 for spin tables in the EFI
	  memory map

endif
```

## configs/fancom_whc_defconfig
```kconfig
CONFIG_ARM=y
CONFIG_ARCH_BCM283X=y
CONFIG_TARGET_FANCOM_WHC=y
CONFIG_SYS_TEXT_BASE=0x00080000
CONFIG_SYS_MALLOC_F_LEN=0x2000
CONFIG_DISTRO_DEFAULTS=y
CONFIG_OF_BOARD_SETUP=y
CONFIG_USE_PREBOOT=y
CONFIG_PREBOOT="pci enum; usb start;"
# CONFIG_DISPLAY_CPUINFO is not set
# CONFIG_DISPLAY_BOARDINFO is not set
CONFIG_MISC_INIT_R=y
CONFIG_SYS_PROMPT="Fancom WHC> "
CONFIG_CMD_GPIO=y
CONFIG_CMD_MMC=y
CONFIG_CMD_PCI=y
CONFIG_CMD_USB=y
CONFIG_CMD_FS_UUID=y
CONFIG_OF_BOARD=y
# CONFIG_ENV_FAT_DEVICE_AND_PART is not set
CONFIG_ENV_VARS_UBOOT_RUNTIME_CONFIG=y
CONFIG_DM_DMA=y
CONFIG_DM_MMC=y
CONFIG_MMC_SDHCI=y
CONFIG_MMC_SDHCI_SDMA=y
CONFIG_MMC_SDHCI_BCM2835=y
CONFIG_DM_ETH=y
CONFIG_BCMGENET=y
CONFIG_PCI=y
CONFIG_DM_PCI=y
CONFIG_PCI_BRCMSTB=y
CONFIG_PINCTRL=y
# CONFIG_PINCTRL_GENERIC is not set
CONFIG_DM_RESET=y
CONFIG_DM_RNG=y
CONFIG_RNG_IPROC200=y
# CONFIG_REQUIRE_SERIAL_CONSOLE is not set
CONFIG_USB=y
CONFIG_DM_USB=y
CONFIG_USB_XHCI_HCD=y
CONFIG_USB_XHCI_PCI=y
CONFIG_USB_DWC2=y
CONFIG_USB_KEYBOARD=y
CONFIG_USB_HOST_ETHER=y
CONFIG_USB_ETHER_LAN78XX=y
CONFIG_USB_ETHER_SMSC95XX=y
CONFIG_DM_VIDEO=y
# CONFIG_VIDEO_BPP8 is not set
# CONFIG_VIDEO_BPP16 is not set
CONFIG_SYS_WHITE_ON_BLACK=y
CONFIG_CONSOLE_SCROLL_LINES=10
CONFIG_PHYS_TO_BUS=y
CONFIG_OF_LIBFDT_OVERLAY=y
#
# Added for Fancom
#
CONFIG_ENV_IS_IN_MMC=y
CONFIG_SYS_MMC_ENV_DEV=0
CONFIG_ENV_SIZE=0x20000
CONFIG_ENV_OFFSET=0x400000
# CONFIG_ENV_SECT_SIZE is not set
CONFIG_SYS_REDUNDAND_ENVIRONMENT=y
CONFIG_ENV_SIZE_REDUND=0x20000
CONFIG_ENV_OFFSET_REDUND=0x420000
CONFIG_AUTOBOOT=y
CONFIG_AUTOBOOT_KEYED=y
CONFIG_AUTOBOOT_STOP_STR="3215b9d0"
# CONFIG_ENV_FAT_INTERFACE is not set
# CONFIG_ENV_FAT_DEVICE_AND_PART is not set
# CONFIG_ENV_FAT_FILE is not set
# CONFIG_ENV_IS_IN_FAT is not set
# CONFIG_ENV_FAT_INTERFACE is not set
# CONFIG_ENV_FAT_DEVICE_AND_PART is not set
# CONFIG_ENV_FAT_FILE is not set
```
